/*
	File:		LThermometerPane.h

	Contains:	Thermometer indicator pane for PowerPlant.
				An LProgressIndicator subclass.
				
	Version:	2.0

	Author:		Chris K. Thomas, ckt@best.com
	
	Copyright:	©1995 Chris K. Thomas.  All Rights Reserved.
*/

#pragma once

#include <LPane.h>

class LThermometerPane :	public LPane
{
	SInt32		mMinValue, mMaxValue;	// * start and end value
	SInt32		mCurValue;				// * current value
	short					mRight;
	short					mOriginOffset;
	
public:
	
	enum {
		class_ID = 'Tmtr'
	};

						LThermometerPane(LStream *inStream);
						LThermometerPane(const SPaneInfo &inPaneInfo, SInt32 inMin = 1, SInt32 inMax = 100, SInt32 inValue = 1);
	
	virtual				~LThermometerPane();
	
	//
	// * incrementing
	//
	void 			CompletedThisMuchMore(SInt32 inThisMuch);// * relative to current value
	void 			CompletedThisMuch(SInt32);				// * absolute - replaces current value
	
	//
	// * accessors
	//
	inline void SetValues(SInt32 inMin, SInt32 inMax, SInt32 inValue);
	inline void SetCurrentValue(SInt32 inCurValue);	// equivalent to CompletedThisMuch()
	inline void SetMinValue(SInt32 inMinValue);
	inline void SetMaxValue(SInt32 inMaxValue);
	
	inline SInt32		GetCurrentValue();
	inline SInt32		GetMinValue();
	inline SInt32		GetMaxValue();

	virtual void		ValueChanged();
	virtual void		DrawSelf();
	
protected:
	void DrawBox();
	void DrawInside();
};


inline void
LThermometerPane::SetValues(SInt32 inMin, SInt32 inMax, SInt32 inValue)
{
	mMinValue = inMin;
	mMaxValue = inMax;
	mCurValue = inValue;
	
	//
	// CompletedThisMuch calls ValueChanged, but we also need
	// to call it when only the min and max have changed
	//
	
	if(inValue != mCurValue)
		CompletedThisMuch(inValue);
	else
		ValueChanged();
}

inline void
LThermometerPane::SetCurrentValue(SInt32 inCurValue)
{
	if(inCurValue != mCurValue)
		CompletedThisMuch(inCurValue);
}

inline void
LThermometerPane::SetMinValue(SInt32 inMinValue)
{
	if(mMinValue != inMinValue)
	{
		mMinValue = inMinValue;
		ValueChanged();
	}
}

inline void
LThermometerPane::SetMaxValue(SInt32 inMaxValue)
{
	if(mMaxValue != inMaxValue)
	{
		mMaxValue = inMaxValue;
		ValueChanged();
	}
}

inline SInt32
LThermometerPane::GetCurrentValue()
{
	return mCurValue;
}

inline SInt32
LThermometerPane::GetMinValue()
{
	return mMinValue;
}

inline SInt32
LThermometerPane::GetMaxValue()
{
	return mMaxValue;
}


